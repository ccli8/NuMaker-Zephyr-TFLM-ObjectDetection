## boards/shields/himax_hm1055/Kconfig.shield
```kconfig
# Copyright (c) 2025 Nuvoton Technology Corporation
# SPDX-License-Identifier: Apache-2.0

config SHIELD_HIMAX_HM1055
	def_bool $(shields_list_contains,himax_hm1055)
```

## boards/shields/ids_fsa506/Kconfig.shield
```kconfig
# Copyright (c) 2025 Nuvoton Technology Corporation
# SPDX-License-Identifier: Apache-2.0

config SHIELD_IDS_FSA506
	def_bool $(shields_list_contains,ids_fsa506)
```

## boards/shields/ilium_ili9341/Kconfig.defconfig
```kconfig
# Copyright (c) 2025 Nuvoton Technology Corporation
# SPDX-License-Identifier: Apache-2.0

if SHIELD_ILIUM_ILI9341

config SPI
	default y

endif # SHIELD_ILIUM_ILI9341
```

## boards/shields/ilium_ili9341/Kconfig.shield
```kconfig
# Copyright (c) 2025 Nuvoton Technology Corporation
# SPDX-License-Identifier: Apache-2.0

config SHIELD_ILIUM_ILI9341
	def_bool $(shields_list_contains,ilium_ili9341)
```

## boards/shields/levetop_lt7381/Kconfig.shield
```kconfig
# Copyright (c) 2025 Nuvoton Technology Corporation
# SPDX-License-Identifier: Apache-2.0

config SHIELD_LEVETOP_LT7381
	def_bool $(shields_list_contains,levetop_lt7381)
```

## boards/shields/winbond_hyperram/Kconfig.shield
```kconfig
# Copyright (c) 2025 Nuvoton Technology Corporation
# SPDX-License-Identifier: Apache-2.0

config SHIELD_WINBOND_HYPERRAM
	def_bool $(shields_list_contains,winbond_hyperram)
```
